## conf/layer.conf
```bitbake
# We have a conf and classes directory, add to BBPATH
BBPATH .= ":${LAYERDIR}"

# We have recipes-* directories, add to BBFILES
BBFILES += "${LAYERDIR}/recipes-*/*/*.bb \
	    ${LAYERDIR}/recipes-*/*/*.bbappend"

BBFILE_COLLECTIONS += "seco-rockchip"
BBFILE_PATTERN_seco-rockchip := "^${LAYERDIR}/"
BBFILE_PRIORITY_seco-rockchip = "9"

RKBASE = '${@os.path.normpath("${LAYERDIR}")}'
BB_BASEHASH_IGNORE_VARS:append = " RKBASE"

# Additional license directories.
LICENSE_PATH += "${LAYERDIR}/licenses"

LAYERDEPENDS_seco-rockchip = "core openembedded-layer"

# This should only be incremented on significant changes that will
# cause compatibility issues with other layers
LAYERVERSION_seco-rockchip = "1"
LAYERSERIES_COMPAT_seco-rockchip = "kirkstone"
```

## conf/machine/include/px30.inc
```bitbake
# Copyright (c) 2019, Fuzhou Rockchip Electronics Co., Ltd
# Released under the MIT license (see COPYING.MIT for the terms)

SOC_FAMILY ?= "px30"
require conf/machine/include/rockchip-arm64-common.inc

MALI_GPU := "bifrost-g31"
MALI_VERSION := "g2p0"

IMAGE_FSTYPES += "wic.bmap"
BOOT_DEV ?= "emmc"
IMAGE_LINK_NAME = "${IMAGE_BASENAME}-${MACHINE}-${BOOT_DEV}"

# Install regulatory DB in /lib/firmware for kernel to load
IMAGE_INSTALL:append = " wireless-regdb-static"

# The source image of the Rauc bundle has the following name
# scheme: RAUC_SLOT_system - MACHINE . RAUC_SLOT_system[fstype]
# see oniro-bundle-base.bb for more details
IMAGE_POSTPROCESS_COMMAND:append = " link_rauc_src_image;"
link_rauc_src_image() {
        ln -sf "${IMAGE_LINK_NAME}.${ROOT_FSTYPE}" \
                "${IMGDEPLOYDIR}/${IMAGE_BASENAME}-${MACHINE}.${ROOT_FSTYPE}"
}
```

## conf/machine/include/rockchip-common.inc
```bitbake
# Copyright (c) 2019, Fuzhou Rockchip Electronics Co., Ltd
# Released under the MIT license (see COPYING.MIT for the terms)

require conf/machine/include/soc-family.inc

MACHINE_EXTRA_RRECOMMENDS:append = " \
	${RK_WIFIBT_FIRMWARES} \
	kernel-modules \
"

SERIAL_CONSOLES ?= "115200;ttyFIQ0"
KERNEL_IMAGETYPE ?= "Image"
MACHINEOVERRIDES .= ":rockchip"

# Firmware
MACHINE_FIRMWARE ?= ""
MACHINE_EXTRA_RRECOMMENDS += "${MACHINE_FIRMWARE}"

PREFERRED_PROVIDER_virtual/bootloader = "u-boot-seco"
PREFERRED_VERSION_u-boot-toradex = "2017.09%"

PREFERRED_PROVIDER_virtual/kernel ?= "linux-seco"
PREFERRED_VERSION_linux-seco ?= "5.10%"
LINUXLIBCVERSION ?= "5.10%"

# Custom kernel might not support newest python
PACKAGECONFIG:remove:pn-perf = " scripting"

PREFERRED_PROVIDER_virtual/egl ?= "${@'rockchip-libmali' if d.getVar('TCLIBC') == 'glibc' else 'mesa'}"
PREFERRED_PROVIDER_virtual/libgles1 ?= "${@'rockchip-libmali' if d.getVar('TCLIBC') == 'glibc' else 'mesa'}"
PREFERRED_PROVIDER_virtual/libgles2 ?= "${@'rockchip-libmali' if d.getVar('TCLIBC') == 'glibc' else 'mesa'}"
PREFERRED_PROVIDER_virtual/libgles3 ?= "${@'rockchip-libmali' if d.getVar('TCLIBC') == 'glibc' else 'mesa'}"
PREFERRED_PROVIDER_virtual/libopencl ?= "${@'rockchip-libmali' if d.getVar('TCLIBC') == 'glibc' else 'mesa'}"
PREFERRED_PROVIDER_virtual/libgbm ?= "${@'rockchip-libmali' if d.getVar('TCLIBC') == 'glibc' else 'mesa'}"
PACKAGECONFIG:pn-wayland ?= "${@bb.utils.contains('DISTRO_FEATURES', 'wayland', 'no-egl', '', d)}"

DEPENDS:append:pn-mesa-gl = "${@'rockchip-libmali' if d.getVar('TCLIBC') == 'glibc' else ''}"

PREFERRED_PROVIDER_virtual/libgl ?= "${@'mesa-gl' if d.getVar('TCLIBC') == 'glibc' else 'mesa'}"
PREFERRED_PROVIDER_virtual/mesa ?= "${@'mesa-gl' if d.getVar('TCLIBC') == 'glibc' else 'mesa'}"

PREFERRED_RPROVIDER_lib32-initd-functions = "lib32-initscripts"

export RK_ROOTDEV_UUID ?= "614e0000-0000-4b53-8000-1d28000054a9"
export RK_PARTITION_GROW ?= "1"

RK_USE_COMPRESSED_KERNEL ?= "1"
RDEPENDS:${KERNEL_PACKAGE_NAME}-base = ""

RK_MINILOADER_INI ?= "${@d.getVar('SOC_FAMILY').upper() + 'MINIALL.ini'}"
RK_TRUST_INI ?= "${@d.getVar('SOC_FAMILY').upper() + 'TOS.ini'}"
RK_IGNORE_BL32 ?= "0"

# loader's size(K) and backup num
RK_LOADER_SIZE ?= "1024"
RK_LOADER_BACKUP_NUM ?= "4"

IMAGE_FSTYPES:remove = "iso live"
export RK_ROOTFS_TYPE ?= "ext4"

IMAGE_FSTYPES:append = " ${RK_ROOTFS_TYPE} wic"
WKS_FILE ?= "gptdisk.wks.in"

# Some partitons, e.g. trust, are allowed to be optional.
do_image_wic[depends] += " \
	virtual/kernel:do_deploy \
	virtual/bootloader:do_deploy \
"
IMAGE_BOOT_FILES ?= " \
	${KERNEL_IMAGETYPE} \
	${IMG_KERNEL_DEVICETREE} \
"

RK_POST_ROOTFS_SCRIPTS ?= ""
RK_OVERLAY_DIRS ?= ""
BB_BASEHASH_IGNORE_VARS:append = " RK_POST_ROOTFS_SCRIPTS RK_OVERLAY_DIRS"

# <fslabel:mountpoint> e.g. "oem:/oem userdata:/userdata"
RK_EXTRA_VOLUMES ?= ""

ROOTFS_POSTPROCESS_COMMAND:append = " do_post_rootfs;"
do_rootfs[depends] += "rsync-native:do_populate_sysroot"
do_post_rootfs() {
	for volume in ${RK_EXTRA_VOLUMES};do
		echo "Creating ${volume##*:} for ${volume%:*}(fslabel)..."
		mkdir -p "${IMAGE_ROOTFS}${volume##*:}"

		echo "PARTLABEL=${volume%:*}\t${volume##*:}\tauto defaults 0 2" \
			>> "${IMAGE_ROOTFS}/etc/fstab"
	done

	for overlay in ${RK_OVERLAY_DIRS};do
		[ -d "${overlay}" ] || continue
		echo "Installing overlay: ${overlay}..."
		rsync -av --chmod=u=rwX,go=rX "${overlay}/" "${IMAGE_ROOTFS}"
	done

	for script in ${RK_POST_ROOTFS_SCRIPTS};do
		[ -f "${script}" ] || continue
		echo "Running script: ${script}..."
		cd "${script%/*}"
		"${script}" "${IMAGE_ROOTFS}"
	done
}

IMAGE_POSTPROCESS_COMMAND:append = " link_rootfs_image;"
link_rootfs_image() {
	ln -sf "${IMAGE_LINK_NAME}.${RK_ROOTFS_TYPE}" \
		"${IMGDEPLOYDIR}/rootfs.img"
}

IMAGE_POSTPROCESS_COMMAND:append = " gen_rkparameter;"
gen_rkparameter() {
	IMAGE="${IMGDEPLOYDIR}/${IMAGE_LINK_NAME}.wic"
	if [ ! -f "${IMAGE}" ];then
		echo "${IMAGE} not found."
		return
	fi

	cd "${IMGDEPLOYDIR}"

	OUT="${IMAGE_LINK_NAME}.parameter"
	ln -sf "${OUT}" parameter

	echo "Generating ${OUT}..."

	echo "# IMAGE_NAME: $(readlink ${IMAGE})" > "${OUT}"
	echo "FIRMWARE_VER: 1.0" >> "${OUT}"
	echo "TYPE: GPT" >> "${OUT}"
	echo -n "CMDLINE: mtdparts=rk29xxnand:" >> "${OUT}"
	sgdisk -p "${IMAGE}" | grep -E "^ +[0-9]" | while read line;do
		NAME=$(echo ${line} | cut -f 7 -d ' ')
		START=$(echo ${line} | cut -f 2 -d ' ')
		END=$(echo ${line} | cut -f 3 -d ' ')
		SIZE=$(expr ${END} - ${START} + 1)
		printf "0x%08x@0x%08x(%s)," ${SIZE} ${START} ${NAME} >> "${OUT}"
	done
	echo >> "${OUT}"

	if [ "$RK_PARTITION_GROW" = "1" ];then
		sed -i "s/[^,]*\(@[^,]*\)),$/-\1:grow)/" "${OUT}"
	fi

	echo "uuid: rootfs=${RK_ROOTDEV_UUID}" >> "${OUT}"
}

IMAGE_POSTPROCESS_COMMAND:append = " link_latest_image;"
link_latest_image() {
	rm -rf "${TOPDIR}/latest"
	ln -sf "${DEPLOY_DIR_IMAGE}" "${TOPDIR}/latest"
}
```

## conf/machine/seco-px30-d23.conf
```bitbake
#@TYPE: Machine
#@NAME: SECO SBC-D23
#@SOC: PX30
#@DESCRIPTION: Machine configuration for Seco's reference board Juno (Single Board Computer D23)
#based on Rockchip PX30 Applications Processors

require conf/machine/include/px30.inc

PREFERRED_PROVIDER_virtual/kernel = "linux-seco"
PREFERRED_VERSION_linux-seco = "5.10%"
LINUXLIBCVERSION = "5.10%"

PREFERRED_PROVIDER_virtual/bootloader = "u-boot"

KBUILD_DEFCONFIG = "seco_px30_d23-linux_defconfig"

KERNEL_DEVICETREE = " \
	seco/seco-px30-d23-revc-hdmi.dtb \
	seco/seco-px30-d23-revc-lvds.dtb \
	seco/seco-px30-d23-revc-lvds-800x480.dtb \
	seco/seco-px30-d23-revc-hdmi-lvds-1280x800.dtb \
	seco/seco-px30-d23-revc-hdmi-lvds.dtb \
	seco/seco-px30-d23-revc-lvds-1024x600.dtb \
	seco/seco-px30-d23-revc-lvds-1280x800.dtb \
"

IMG_KERNEL_DEVICETREE = " \
	seco-px30-d23-revc-hdmi.dtb \
	seco-px30-d23-revc-lvds.dtb \
	seco-px30-d23-revc-lvds-800x480.dtb \
	seco-px30-d23-revc-hdmi-lvds-1280x800.dtb \
	seco-px30-d23-revc-hdmi-lvds.dtb \
	seco-px30-d23-revc-lvds-1024x600.dtb \
	seco-px30-d23-revc-lvds-1280x800.dtb \
"
IMAGE_BOOT_FILES += " \
	uEnvD23.txt \
	seco_boot.scr \
"
UBOOT_MACHINE = "seco_px30_d23_defconfig"

RK_WIFIBT_FIRMWARES = " "
MACHINE_FIRMWARE:append = " linux-firmware-bcm43455"

MACHINE_EXTRA_RRECOMMENDS:append = " \
	kernel-modules \
	alsa-utils-aplay \
	alsa-utils-amixer \
"
# libmali.so is bound to glibc and can be used only on glibc-based systems.
MACHINE_EXTRA_RRECOMMENDS:append = "${@' rockchip-libmali' if d.getVar('TCLIBC') == 'glibc' else ''}"
MACHINE_FEATURES:append = " wifi bluetooth"

EFI_PROVIDER = "grub-efi"
IMAGE_EFI_BOOT_FILES += " \
	${IMG_KERNEL_DEVICETREE} \
	${IMAGE_BOOT_FILES} \
"

WKS_FILE_DEPENDS:append = "${@bb.utils.contains('EFI_PROVIDER', 'grub-efi', ' grub-efi', '', d)}"

#Uncomment these lines below, if you want to build image to boot from a USB flash drive.
#Note that you need to flash bootloader firmware into emmc first.
#BOOT_DEV = "usbdisk"
#WKS_FILE = "usbdisk.wks.in"
```
